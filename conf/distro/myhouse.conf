## conf/distro/myhouse.conf
```bitbake
# We provide a minimal set of customisation on top of the OE-Core defaultsetup
# distro configuration — this file is included in a parse by default via
# bitbake.conf so our custom distro can be nice and slim.

DISTRO_NAME = "myHouse"
DISTRO_CODENAME = "myHouse distro demonstrating use of meta-swupd"

# We'll need to bump this each time we want to generate new swupd update
# artefacts. The general recommendation is to use increments of 10 for public
# releases, allowing the 9 release in-between to be used for internal/QA
# releases, hotfix releases, etc. depending on what makes sense for the OS
# developer.
DISTRO_VERSION = "2"

# swupd assumes systemd, and we like systemd, so enable it and disable sysvinit
DISTRO_FEATURES_append = " systemd"
VIRTUAL-RUNTIME_init_manager = "systemd"
DISTRO_FEATURES_BACKFILL_CONSIDERED = "sysvinit"
VIRTUAL-RUNTIME_initscripts = ""

# Any GUI we use must be a modern, secure, wayland-based GUI
DISTRO_FEATURES_append = " wayland"
DISTRO_FEATURES_remove = "x11"

# We only use packaging as an artefact of image construction, therefore we
# want the quickest/cheapest package format
PACKAGE_CLASSES = "package_ipk"

# Enable compiler hardening features
require conf/distro/include/security_flags.inc

# swupd requires a reasonable amount of free space to download the updates
# and apply them
# TODO: sanity check this setting.
IMAGE_ROOTFS_EXTRA_SPACE = "512000"
# Prevent the extra space from inflating the initramfs image and triggering an
# error when the initramfs rootfs is larger than INITRAMFS_MAXSIZE.
IMAGE_ROOTFS_EXTRA_SPACE_pn-core-image-minimal-initramfs = "0"

# Use the available sanity checks to verify our os-core bundle is sound
SWUPD_IMAGE_SANITY_CHECKS += " \
     swupd_check_dangling_symlinks \
"

# Files we don't want to include in the swupd manifests
SWUPD_FILE_BLACKLIST = "\
    /etc/machine-id \
    /etc/mtab \
"

# Don't create /etc/ld.so.cache — systemd will recreate it when booting anyway
# and cause hash mismatches when running `swupd verify`
LDCONFIGDEPEND = ""

# swupd 2.x series is better tested at this point
# PREFERRED_VERSION_swupd-server-native = "2.53"
# PREFERRED_VERSION_swupd-client-native = "2.87"
# PREFERRED_VERSION_swupd-server = "2.53"
# PREFERRED_VERSION_swupd-client = "2.87"
```

## conf/layer.conf
```bitbake
# We have a conf and classes directory, add to BBPATH
BBPATH .= ":${LAYERDIR}"

# We have recipes-* directories, add to BBFILES
BBFILES += "${LAYERDIR}/recipes-*/*/*.bb \
	${LAYERDIR}/recipes-*/*/*.bbappend"

BBFILE_COLLECTIONS += "myhouse"
BBFILE_PATTERN_myhouse = "^${LAYERDIR}/"
BBFILE_PRIORITY_myhouse = "6"
```
